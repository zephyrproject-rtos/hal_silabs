## CMakeLists.txt
```
# Copyright (c) 2023 Silicon Laboratories Inc.
# SPDX-License-Identifier: Zlib

cmake_minimum_required(VERSION 3.20.0)
find_package(Zephyr REQUIRED HINTS $ENV{ZEPHYR_BASE})
project(propriatery_trx)

target_include_directories(app PRIVATE
    src/
    src/autogen/
    src/config/
    src/config/rail
    src/config/rail/${CONFIG_BOARD}
)

target_sources(app PRIVATE src/main.c)
target_sources(app PRIVATE src/app_gpio.c)
target_sources(app PRIVATE src/app_cli.c)
target_sources(app PRIVATE src/app_rail.c)
target_sources(app PRIVATE src/autogen/sl_rail_util_callbacks.c)
target_sources(app PRIVATE src/autogen/sl_rail_util_init.c)
target_sources(app PRIVATE src/config/rail/${CONFIG_BOARD}/rail_config.c)
```

## prj.conf
```kconfig
# Copyright (c) 2024 Silicon Laboratories Inc.
# SPDX-License-Identifier: Zlib
CONFIG_GPIO=y
CONFIG_SOC_GECKO_CUSTOM_RADIO_PHY=y
CONFIG_FPU=y
CONFIG_PM=y
CONFIG_PRINTK=y
CONFIG_LOG=y
CONFIG_SHELL=y
CONFIG_EVENTS=y
CONFIG_ASSERT=y
CONFIG_BOOT_BANNER=y
CONFIG_POSIX_CLOCK=y
CONFIG_INIT_STACKS=y
CONFIG_SMF=y
```

## prj_efr32xg24_dk2601b.conf
```kconfig
# Copyright (c) 2023 Silicon Laboratories Inc.
# SPDX-License-Identifier: Zlib
CONFIG_GPIO=y
CONFIG_SOC_GECKO_CUSTOM_RADIO_PHY=y
CONFIG_FPU=y
CONFIG_PRINTK=y
CONFIG_LOG=y
CONFIG_SHELL=y
CONFIG_EVENTS=y
CONFIG_ASSERT=y
CONFIG_BOOT_BANNER=y
CONFIG_POSIX_CLOCK=y
CONFIG_INIT_STACKS=y
CONFIG_SMF=y
```

## boards/efr32xg24_dk2601b.overlay
```dts
/*
 * Copyright (c) 2023 Silicon Laboratories Inc.
 * SPDX-License-Identifier: Zlib
 */

&cpu0 {
	cpu-power-states = <&pstate_em0>;
};
```

## src/main.c
```c
/***************************************************************************//**
 * @file main.c
 * @brief Main file for the proprietary_trx example.
 *******************************************************************************
 * # License
 * <b>Copyright 2024 Silicon Laboratories Inc. www.silabs.com</b>
 *******************************************************************************
 *
 * SPDX-License-Identifier: Zlib
 *
 * The licensor of this software is Silicon Laboratories Inc.
 *
 * This software is provided 'as-is', without any express or implied
 * warranty. In no event will the authors be held liable for any damages
 * arising from the use of this software.
 *
 * Permission is granted to anyone to use this software for any purpose,
 * including commercial applications, and to alter it and redistribute it
 * freely, subject to the following restrictions:
 *
 * 1. The origin of this software must not be misrepresented; you must not
 *    claim that you wrote the original software. If you use this software
 *    in a product, an acknowledgment in the product documentation would be
 *    appreciated but is not required.
 * 2. Altered source versions must be plainly marked as such, and must not be
 *    misrepresented as being the original software.
 * 3. This notice may not be removed or altered from any source distribution.
 *
 ******************************************************************************/

// -----------------------------------------------------------------------------
// Includes

#include <zephyr/kernel.h>
#include <zephyr/device.h>
#include <zephyr/drivers/gpio.h>
#include <zephyr/sys/util.h>
#include <zephyr/sys/printk.h>
#include <inttypes.h>
#include <zephyr/shell/shell.h>
#include <zephyr/logging/log.h>
#include "rail.h"
#include "rail_types.h"
#include "pa_conversions_efr32.h"
#include "sl_rail_util_init.h"
#include "app_gpio.h"
#include "app_rail.h"
#include "main.h"

// -----------------------------------------------------------------------------
// Macros and Typedefs
LOG_MODULE_REGISTER(trx_app_log, LOG_LEVEL_INF);

/* List of application states */
enum radio_state {
	INIT,
	IDLE,
	SEND,
	SENT,
	RECEIVE,
	ERROR
};

// -----------------------------------------------------------------------------
// Static Function Declarations

static void init_run(void *o);
static void idle_run(void *o);
static void send_run(void *o);
static void sent_run(void *o);
static void received_run(void *o);
static void error_run(void *o);

// -----------------------------------------------------------------------------
// Global Variables

//
struct s_prop_var s_sl_machine = {.led1 = GPIO_DT_SPEC_GET_OR(DT_ALIAS(led1), gpios, {0}),
				  .led0 = GPIO_DT_SPEC_GET_OR(DT_ALIAS(led0), gpios, {0}),
				  .button1 = GPIO_DT_SPEC_GET_OR(DT_ALIAS(sw1), gpios, {0}),
				  .button0 = GPIO_DT_SPEC_GET_OR(DT_ALIAS(sw0), gpios, {0})};

// -----------------------------------------------------------------------------
// Static Variables

static const struct smf_state radio_states[] = {
	[INIT] = SMF_CREATE_STATE(NULL, init_run, NULL),
	[IDLE] = SMF_CREATE_STATE(NULL, idle_run, NULL),
	[SEND] = SMF_CREATE_STATE(NULL, send_run, NULL),
	[SENT] = SMF_CREATE_STATE(NULL, sent_run, NULL),
	[RECEIVE] = SMF_CREATE_STATE(NULL, received_run, NULL),
	[ERROR] = SMF_CREATE_STATE(NULL, error_run, NULL),

};

// -----------------------------------------------------------------------------
// Public Function Definitions

int main(void)
{
	uint8_t ret = 0;
	uint32_t incoming_events = 0;
	/* Initialize the event */
	k_event_init(&s_sl_machine.smf_event);
	smf_set_initial(&s_sl_machine.ctx, &radio_states[INIT]);

	while (1) {
		ret = smf_run_state(&s_sl_machine.ctx);
		if (ret) {
			return -1;
		}

		/* Block until an event is detected */
		incoming_events =
			k_event_wait(&s_sl_machine.smf_event,
				     (EVENT_REQUEST_SEND | EVENT_RADIO_SENT | EVENT_RADIO_RECEIVED |
				      EVENT_CLI_RECEIVE_SETTING | EVENT_RADIO_ERROR),
				     false, K_FOREVER);

		if (incoming_events & EVENT_REQUEST_SEND) {
			smf_set_state(&s_sl_machine.ctx, &radio_states[SEND]);
		}
		if (incoming_events & EVENT_RADIO_SENT) {
			smf_set_state(&s_sl_machine.ctx, &radio_states[SENT]);
		}
		if (incoming_events & EVENT_RADIO_RECEIVED) {
			smf_set_state(&s_sl_machine.ctx, &radio_states[RECEIVE]);
		}
		if (incoming_events & EVENT_RADIO_ERROR) {
			smf_set_state(&s_sl_machine.ctx, &radio_states[ERROR]);
		}
	}
	return 0;
}

// -----------------------------------------------------------------------------
// Static Function Definitions

static void init_run(void *o)
{
	RAIL_Version_t rail_version;
	struct s_prop_var *s = o;
	LOG_INF("INIT STATE");
	if (app_init_gpios(s)) {
		LOG_ERR("LED and Button init failed!");
	}
	app_rail_init();
	RAIL_GetVersion(&rail_version, 1);
	printk("RAIL LIB version: %d.%d.%d\n", rail_version.major, rail_version.minor,
	       rail_version.rev);
	printk("            HASH: %u\n", rail_version.hash);
	printk("Press the button\n");
	s->packet_sent = true;
	smf_set_state(&s->ctx, &radio_states[IDLE]);
}

static void idle_run(void *o)
{
	struct s_prop_var *s = o;
	LOG_INF("IDLE STATE");
	if (k_event_test(&(s->smf_event), EVENT_CLI_RECEIVE_SETTING)) {
		set_continuous_rx(s->allow_rx);
		k_event_clear(&(s->smf_event), EVENT_CLI_RECEIVE_SETTING);
	}
}

static void send_run(void *o)
{
	struct s_prop_var *s = o;
	LOG_INF("SEND STATE");
	handle_send(&(s->packet_sent));
	smf_set_state(&s->ctx, &radio_states[IDLE]);
	k_event_clear(&(s->smf_event), EVENT_REQUEST_SEND);
}

static void sent_run(void *o)
{
	struct s_prop_var *s = o;
	LOG_INF("SENT STATE");
	handle_sent(&(s->packet_sent));
	app_update_send_led(s);
	smf_set_state(&s->ctx, &radio_states[IDLE]);
	k_event_clear(&(s->smf_event), EVENT_RADIO_SENT);
}

static void received_run(void *o)
{
	struct s_prop_var *s = o;
	LOG_INF("RECEIVE STATE");
	handle_receive();
	app_update_receive_led(s);
	smf_set_state(&s->ctx, &radio_states[IDLE]);
	k_event_clear(&(s->smf_event), EVENT_RADIO_RECEIVED);
}

static void error_run(void *o)
{
	struct s_prop_var *s = o;
	LOG_INF("ERROR STATE");
	handle_error(&(s->error_code));
	smf_set_state(&s->ctx, &radio_states[IDLE]);
	k_event_clear(&(s->smf_event), EVENT_RADIO_ERROR);
}
```

## src/app_cli.c
```c
/***************************************************************************//**
 * @file app_cli.c
 * @brief CLI commands for the proprietary_trx example.
 *******************************************************************************
 * # License
 * <b>Copyright 2024 Silicon Laboratories Inc. www.silabs.com</b>
 *******************************************************************************
 *
 * SPDX-License-Identifier: Zlib
 *
 * The licensor of this software is Silicon Laboratories Inc.
 *
 * This software is provided 'as-is', without any express or implied
 * warranty. In no event will the authors be held liable for any damages
 * arising from the use of this software.
 *
 * Permission is granted to anyone to use this software for any purpose,
 * including commercial applications, and to alter it and redistribute it
 * freely, subject to the following restrictions:
 *
 * 1. The origin of this software must not be misrepresented; you must not
 *    claim that you wrote the original software. If you use this software
 *    in a product, an acknowledgment in the product documentation would be
 *    appreciated but is not required.
 * 2. Altered source versions must be plainly marked as such, and must not be
 *    misrepresented as being the original software.
 * 3. This notice may not be removed or altered from any source distribution.
 *
 ******************************************************************************/

// -----------------------------------------------------------------------------
// Includes

#include <zephyr/kernel.h>
#include <zephyr/device.h>
#include <zephyr/drivers/gpio.h>
#include <zephyr/sys/util.h>
#include <zephyr/sys/printk.h>
#include <inttypes.h>
#include <zephyr/shell/shell.h>
#include <zephyr/logging/log.h>
#include <stdlib.h>
#include "em_chip.h"
#include "main.h"

// -----------------------------------------------------------------------------
// Public Function Definitions

/******************************************************************************
 * CLI - send: Sets a flag indicating that a packet has to be sent
 *****************************************************************************/
void cli_send_packet(const struct shell *sh, size_t argc, char **argv)
{
	shell_fprintf(sh, SHELL_NORMAL, "Send packet request\n");
	k_event_post(&s_sl_machine.smf_event, EVENT_REQUEST_SEND);
}

/******************************************************************************
 * CLI - info message: Unique ID of the board
 *****************************************************************************/
void cli_info(const struct shell *sh, size_t argc, char **argv)
{
	shell_fprintf(sh, SHELL_NORMAL, "Info:\n");
	shell_fprintf(sh, SHELL_NORMAL, "  MCU Id:       0x%llx\n", SYSTEM_GetUnique());
}

/******************************************************************************
 * CLI - receive: Turn on/off continues packet receiving
 *****************************************************************************/
void cli_receive_packet(const struct shell *sh, size_t argc, char **argv)
{
	unsigned long continues_receive = strtoul(argv[1], NULL, 0);
	s_sl_machine.allow_rx = continues_receive;
	shell_fprintf(sh, SHELL_NORMAL, "Continues packet receiving is %s\n",
		      (continues_receive == 0) ? "OFF" : "ON");
	k_event_post(&s_sl_machine.smf_event, EVENT_CLI_RECEIVE_SETTING);
}

SHELL_CMD_ARG_REGISTER(info, NULL, "Display unique ID of the MCU", cli_info, 1, 0);

SHELL_CMD_ARG_REGISTER(send, NULL, "Send a packet", cli_send_packet, 1, 0);

SHELL_CMD_ARG_REGISTER(receive, NULL, "Turn ON/OFF continues packet receiving", cli_receive_packet,
		       2, 0);
```

## src/app_gpio.c
```c
/***************************************************************************//**
 * @file app_gpio.c
 * @brief GPIO handling for the proprietary_trx example.
 *******************************************************************************
 * # License
 * <b>Copyright 2024 Silicon Laboratories Inc. www.silabs.com</b>
 *******************************************************************************
 *
 * SPDX-License-Identifier: Zlib
 *
 * The licensor of this software is Silicon Laboratories Inc.
 *
 * This software is provided 'as-is', without any express or implied
 * warranty. In no event will the authors be held liable for any damages
 * arising from the use of this software.
 *
 * Permission is granted to anyone to use this software for any purpose,
 * including commercial applications, and to alter it and redistribute it
 * freely, subject to the following restrictions:
 *
 * 1. The origin of this software must not be misrepresented; you must not
 *    claim that you wrote the original software. If you use this software
 *    in a product, an acknowledgment in the product documentation would be
 *    appreciated but is not required.
 * 2. Altered source versions must be plainly marked as such, and must not be
 *    misrepresented as being the original software.
 * 3. This notice may not be removed or altered from any source distribution.
 *
 ******************************************************************************/

// -----------------------------------------------------------------------------
// Includes

#include <zephyr/kernel.h>
#include <zephyr/device.h>
#include <zephyr/drivers/gpio.h>
#include <zephyr/sys/util.h>
#include <zephyr/sys/printk.h>
#include <inttypes.h>
#include <zephyr/shell/shell.h>
#include <zephyr/logging/log.h>
#include "errno.h"
#include "app_gpio.h"

// -----------------------------------------------------------------------------
// Macros and Typedefs

LOG_MODULE_DECLARE(trx_app_log);

// -----------------------------------------------------------------------------
// Static Function Declarations

// Callback function to handle button press for sending a packet
static void button_pressed(const struct device *dev, struct gpio_callback *cb, uint32_t pins);

// Initialize given button to use button_press callback
static int init_button(const struct gpio_dt_spec *button);

static int init_led(const struct gpio_dt_spec *led);

// -----------------------------------------------------------------------------
// Global Variables

// -----------------------------------------------------------------------------
// Static Variables

// -----------------------------------------------------------------------------
// Public Function Definitions

int app_init_gpios(struct s_prop_var *s_state)
{
	BUILD_ASSERT(DT_NODE_HAS_STATUS(DT_ALIAS(sw0), okay),
		     "Unsupported board: sw0 devicetree alias is not defined");
	BUILD_ASSERT(DT_NODE_HAS_STATUS(DT_ALIAS(led0), okay),
		     "Unsupported board: led0 devicetree alias is not defined");

	int ret = 0;
	ret = init_button(&s_state->button0);
	if (ret) {
		return ret;
	}
	if (DT_NODE_HAS_STATUS(DT_ALIAS(sw1), okay)) {
		ret = init_button(&s_state->button1);
		if (ret) {
			return ret;
		}
	}

	ret = init_led(&s_state->led0);
	if (ret) {
		return ret;
	}

	if (DT_NODE_HAS_STATUS(DT_ALIAS(led1), okay)) {
		ret = init_led(&s_state->led1);
		if (ret) {
			return ret;
		}
	}

	return ret;
}

void app_update_receive_led(struct s_prop_var *s_state)
{
	int ret = 0;
	ret = gpio_pin_toggle_dt(&(s_state->led0));
	if (ret) {
		LOG_WRN("Led toggle for led0 returned with %d", ret);
	}
}

void app_update_send_led(struct s_prop_var *s_state)
{
	int ret = 0;
	if (DT_NODE_HAS_STATUS(DT_ALIAS(led1), okay)) {
		ret = gpio_pin_toggle_dt(&s_state->led1);
		if (ret) {
			LOG_WRN("Led toggle for led1 returned with %d", ret);
		}
	} else {
		ret = gpio_pin_toggle_dt(&s_state->led0);
		if (ret) {
			LOG_WRN("Led toggle for led0 returned with %d", ret);
		}
	}
}
// -----------------------------------------------------------------------------
// Static Function Definitions

static void button_pressed(const struct device *dev, struct gpio_callback *cb, uint32_t pins)
{
	struct s_prop_var *context = CONTAINER_OF(cb, struct s_prop_var, button_cb_data);
	k_event_post(&context->smf_event, EVENT_REQUEST_SEND);
}

static int init_button(const struct gpio_dt_spec *button)
{
	int ret = 0;
	if (!gpio_is_ready_dt(button)) {
		LOG_ERR("Error: button device %s is not ready", button->port->name);
		return -EINVAL;
	}

	ret = gpio_pin_configure_dt(button, GPIO_INPUT);
	if (ret) {
		LOG_ERR("Error %d: failed to configure %s pin %d", ret, button->port->name,
			button->pin);
		return ret;
	}

	ret = gpio_pin_interrupt_configure_dt(button, GPIO_INT_EDGE_TO_ACTIVE);
	if (ret) {
		LOG_ERR("Error %d: failed to configure interrupt on %s pin %d", ret,
			button->port->name, button->pin);
		return ret;
	}

	gpio_init_callback(&s_sl_machine.button_cb_data, button_pressed, BIT(button->pin));
	gpio_add_callback(button->port, &s_sl_machine.button_cb_data);

	return 0;
}

static int init_led(const struct gpio_dt_spec *led)
{
	int ret = 0;
	if (led->port && !gpio_is_ready_dt(led)) {
		LOG_ERR("LED device %s is not ready; ignoring it", led->port->name);
		return -EINVAL;
	}

	ret = gpio_pin_configure_dt(led, GPIO_OUTPUT);
	if (ret) {
		LOG_ERR("Error %d: failed to configure LED device %s pin %d", ret, led->port->name,
			led->pin);
		return ret;
	}

	ret = gpio_pin_set_dt(led, 0);
	if (ret) {
		LOG_WRN("Led clear for %s returned with %d", led->port->name, ret);
	}

	return 0;
}
```

## src/app_gpio.h
```c
/***************************************************************************//**
 * @file app_gpio.h
 * @brief GPIO handling for the proprietary_trx example.
 *******************************************************************************
 * # License
 * <b>Copyright 2024 Silicon Laboratories Inc. www.silabs.com</b>
 *******************************************************************************
 *
 * SPDX-License-Identifier: Zlib
 *
 * The licensor of this software is Silicon Laboratories Inc.
 *
 * This software is provided 'as-is', without any express or implied
 * warranty. In no event will the authors be held liable for any damages
 * arising from the use of this software.
 *
 * Permission is granted to anyone to use this software for any purpose,
 * including commercial applications, and to alter it and redistribute it
 * freely, subject to the following restrictions:
 *
 * 1. The origin of this software must not be misrepresented; you must not
 *    claim that you wrote the original software. If you use this software
 *    in a product, an acknowledgment in the product documentation would be
 *    appreciated but is not required.
 * 2. Altered source versions must be plainly marked as such, and must not be
 *    misrepresented as being the original software.
 * 3. This notice may not be removed or altered from any source distribution.
 *
 ******************************************************************************/

#ifndef APP_GPIO_H
#define APP_GPIO_H

#include "main.h"

// -----------------------------------------------------------------------------
// Public Function Declarations

/**
 * @brief Initialize GPIOs for the application.
 *
 * Initializes the GPIOs used by the application.
 * One or two buttons, one is mandatory because of sending.
 * One or two leds, for showing the send, receive packets.
 *
 * @param s_state pointer to the state machine for the led variables
 *
 * @return uint8_t The initialization status. 0 indicates success, and non-zero
 * values indicate an error.
 */
int app_init_gpios(struct s_prop_var *s_state);

/**
 * @brief Update the receive LED status.
 *
 * @param s_state pointer to the state machine for the led variables
 *
 * Updates the status of the receive LED based on the application requirements.
 */
void app_update_receive_led(struct s_prop_var *s_state);

/**
 * @brief Update the send LED status.
 *
 * @param s_state pointer to the state machine for the led variables
 *
 * Updates the status of the send LED based on the application requirements.
 */
void app_update_send_led(struct s_prop_var *s_state);

#endif /*APP_GPIO_H*/
```

## src/app_rail.c
```c
/***************************************************************************//**
 * @file app_rail.c
 * @brief RAIL handling for the proprietary_trx example.
 *******************************************************************************
 * # License
 * <b>Copyright 2024 Silicon Laboratories Inc. www.silabs.com</b>
 *******************************************************************************
 *
 * SPDX-License-Identifier: Zlib
 *
 * The licensor of this software is Silicon Laboratories Inc.
 *
 * This software is provided 'as-is', without any express or implied
 * warranty. In no event will the authors be held liable for any damages
 * arising from the use of this software.
 *
 * Permission is granted to anyone to use this software for any purpose,
 * including commercial applications, and to alter it and redistribute it
 * freely, subject to the following restrictions:
 *
 * 1. The origin of this software must not be misrepresented; you must not
 *    claim that you wrote the original software. If you use this software
 *    in a product, an acknowledgment in the product documentation would be
 *    appreciated but is not required.
 * 2. Altered source versions must be plainly marked as such, and must not be
 *    misrepresented as being the original software.
 * 3. This notice may not be removed or altered from any source distribution.
 *
 ******************************************************************************/

// -----------------------------------------------------------------------------
// Includes

#include <zephyr/kernel.h>
#include <zephyr/device.h>
#include <zephyr/drivers/gpio.h>
#include <zephyr/sys/util.h>
#include <zephyr/sys/printk.h>
#include <inttypes.h>
#include <zephyr/shell/shell.h>
#include <zephyr/logging/log.h>
#include <assert.h>
#include "rail.h"
#include "rail_types.h"
#include "pa_conversions_efr32.h"
#include "sl_rail_util_init.h"
#include "app_rail.h"
#include "main.h"

// -----------------------------------------------------------------------------
// Macros and Typedefs

LOG_MODULE_DECLARE(trx_app_log);

// Generated radio protocol phy have multiply channels to cover the RF band from
// start to end with selected channel spacing, RAIL need to know which is the
// active channel to send/receive, range is from radio_config.c
// from channelNumberStart to channelNumberEnd
#define CHANNEL 0U

// -----------------------------------------------------------------------------
// Static Function Declarations

static void set_up_tx_fifo(RAIL_Handle_t rail_handle);

static void prepare_package(RAIL_Handle_t rail_handle, uint8_t *out_data, uint16_t length);

static uint16_t unpack_packet(uint8_t *rx_destination,
			      const RAIL_RxPacketInfo_t *packet_information,
			      uint8_t **start_of_payload);

// Install RAIL interrupt service routines (ISRs)
static void rail_isr_installer(void);

// -----------------------------------------------------------------------------
// Global Variables

// -----------------------------------------------------------------------------
// Static Variables

// -----------------------------------------------------------------------------
// Public Function Definitions

void handle_send(bool *packet_sent)
{
	// Default payload packet content
	static uint8_t out_packet[16] = {
		0x00, 0x11, 0x22, 0x33, 0x44, 0x55, 0x66, 0x77,
		0x88, 0x99, 0xAA, 0xBB, 0xCC, 0xDD, 0xEE, 0xFF,
	};
	RAIL_Handle_t rail_handle = sl_rail_util_get_handle(SL_RAIL_UTIL_HANDLE_INST0);
	if (*packet_sent) {
		prepare_package(rail_handle, out_packet, sizeof(out_packet));
		LOG_INF("Packet prepared");
		RAIL_StartTx(rail_handle, CHANNEL, RAIL_TX_OPTIONS_DEFAULT, NULL);
		LOG_INF("Packet is being sent");
		*packet_sent = false;
	} else {
		LOG_WRN("Sending is in progress");
	}
}

void handle_sent(bool *packet_sent)
{
	*packet_sent = true;
	LOG_INF("Packet successfully sent");
}

void handle_error(uint64_t *error_code)
{
	LOG_ERR("Radio Error occurred\nEvents: %llX", *error_code);
	*error_code = 0;
}

void set_continuous_rx(bool enable_continuous_rx)
{
	RAIL_Status_t status;
	RAIL_RadioState_t selected_state = RAIL_RF_STATE_IDLE;
	RAIL_StateTransitions_t tx_transitions;
	RAIL_StateTransitions_t rx_transitions;
	RAIL_Handle_t rail_handle = sl_rail_util_get_handle(SL_RAIL_UTIL_HANDLE_INST0);

	if (enable_continuous_rx) {
		selected_state = RAIL_RF_STATE_RX;
	}

	tx_transitions.success = selected_state;
	tx_transitions.error = selected_state;
	rx_transitions.success = selected_state;
	rx_transitions.error = selected_state;

	status = RAIL_SetTxTransitions(rail_handle, &tx_transitions);
	if (status) {
		LOG_ERR("RAIL_SetTxTransitions failed, return value: %d", status);
	} else {
		LOG_INF("RAIL_SetTxTransitions success");
	}

	status = RAIL_SetRxTransitions(rail_handle, &rx_transitions);

	if (status) {
		LOG_ERR("RAIL_SetRxTransitions failed, return value: %d", status);
	} else {
		LOG_INF("RAIL_SetTxTransitions success");
	}

	if (enable_continuous_rx) {
		RAIL_StartRx(rail_handle, CHANNEL, NULL);
	} else {
		RAIL_Idle(rail_handle, RAIL_IDLE, true);
	}
}

void handle_receive(void)
{
	RAIL_RxPacketHandle_t rx_packet_handle;
	RAIL_RxPacketInfo_t packet_info;
	RAIL_Status_t rail_status = RAIL_STATUS_NO_ERROR;
	uint8_t *start_of_packet = NULL;
	uint16_t packet_size = 0;
	static __ALIGNED(RAIL_FIFO_ALIGNMENT) uint8_t rx_fifo[128];
	RAIL_Handle_t rail_handle = sl_rail_util_get_handle(SL_RAIL_UTIL_HANDLE_INST0);
	rx_packet_handle = RAIL_GetRxPacketInfo(rail_handle, RAIL_RX_PACKET_HANDLE_OLDEST_COMPLETE,
						&packet_info);
	while (rx_packet_handle != RAIL_RX_PACKET_HANDLE_INVALID) {
		packet_size = unpack_packet(rx_fifo, &packet_info, &start_of_packet);
		rail_status = RAIL_ReleaseRxPacket(rail_handle, rx_packet_handle);
		if (rail_status) {
			LOG_WRN("RAIL_ReleaseRxPacket() result:%d", rail_status);
		}
		LOG_INF("Length of packet: %d", packet_size);
		LOG_HEXDUMP_INF(start_of_packet, packet_size, "Received Packet: ");
		rx_packet_handle = RAIL_GetRxPacketInfo(
			rail_handle, RAIL_RX_PACKET_HANDLE_OLDEST_COMPLETE, &packet_info);
	}
}

void app_rail_init(void)
{
	RAIL_Status_t status = RAIL_STATUS_NO_ERROR;
	RAIL_Handle_t rail_handle;
	rail_isr_installer();
	sl_rail_util_pa_init();
	sl_rail_util_init();

	rail_handle = sl_rail_util_get_handle(SL_RAIL_UTIL_HANDLE_INST0);
	set_up_tx_fifo(rail_handle);

	status = RAIL_StartRx(rail_handle, CHANNEL, NULL);
	if (status) {
		LOG_WRN("After initialization RAIL_StartRx() result:%d ", status);
	}

	if (IS_ENABLED(CONFIG_PM)) {
		status = RAIL_InitPowerManager();
		if (status) {
			LOG_ERR("RAIL: failed to initialize power management, status=%d", status);
		}
	}
}

/******************************************************************************
 * RAIL callback, called if a RAIL event occurs.
 *****************************************************************************/
/**
 * @brief RAIL callback for handling RAIL events.
 *
 * RAIL event's callback, and it handles RX, TX, and calibration events.
 *
 * @param rail_handle RAIL handle for communication.
 * @param events      RAIL events that occurred.
 */
void sl_rail_util_on_event(RAIL_Handle_t rail_handle, RAIL_Events_t events)
{
	// Contains the status of RAIL Calibration
	static RAIL_Status_t calibration_status = 0;
	s_sl_machine.error_code = events;
	// Handle Rx events
	if (events & RAIL_EVENTS_RX_COMPLETION) {
		if (events & RAIL_EVENT_RX_PACKET_RECEIVED) {
			// Keep the packet in the radio buffer, download it later at the state
			// machine
			RAIL_HoldRxPacket(rail_handle);
			k_event_post(&s_sl_machine.smf_event, EVENT_RADIO_RECEIVED);
		} else {
			k_event_post(&s_sl_machine.smf_event, EVENT_RADIO_ERROR);
		}
	}
	// Handle Tx events
	if (events & RAIL_EVENTS_TX_COMPLETION) {
		if (events & RAIL_EVENT_TX_PACKET_SENT) {
			k_event_post(&s_sl_machine.smf_event, EVENT_RADIO_SENT);
		} else {
			k_event_post(&s_sl_machine.smf_event, EVENT_RADIO_ERROR);
		}
	}

	// Perform all calibrations when needed
	if (events & RAIL_EVENT_CAL_NEEDED) {
		calibration_status = RAIL_Calibrate(rail_handle, NULL, RAIL_CAL_ALL_PENDING);
		if (calibration_status) {
			k_event_post(&s_sl_machine.smf_event, EVENT_RADIO_ERROR);
		}
	}
}

// -----------------------------------------------------------------------------
// Static Function Definitions

static void set_up_tx_fifo(RAIL_Handle_t rail_handle)
{
	uint16_t allocated_tx_fifo_size = 0;
	static __ALIGNED(RAIL_FIFO_ALIGNMENT) uint8_t tx_fifo[128];
	allocated_tx_fifo_size = RAIL_SetTxFifo(rail_handle, tx_fifo, 0, sizeof(tx_fifo));
	if (allocated_tx_fifo_size != sizeof(tx_fifo)) {
		LOG_WRN("RAIL_SetTxFifo allocation failed %d instead of %d", allocated_tx_fifo_size,
			sizeof(tx_fifo));
	}
}

/**
 * Prepares the packet for sending and load it in the RAIL TX FIFO
 *
 * @param rail_handle Which rail handlers should be used for the TX FIFO writing
 * @param out_data The payload buffer
 * @param length The length of the payload
 */
static void prepare_package(RAIL_Handle_t rail_handle, uint8_t *out_data, uint16_t length)
{
	// Check if write fifo has written all bytes
	uint16_t bytes_writen_in_fifo = 0;
	bytes_writen_in_fifo = RAIL_WriteTxFifo(rail_handle, out_data, length, true);
	if (bytes_writen_in_fifo != length) {
		LOG_WRN("RAIL_SetTxFifo allocation failed %d instead of %d", bytes_writen_in_fifo,
			length);
	}
}

/**
 * Helps to unpack the received packet, point to the payload and returns the length.
 *
 * @param rx_destination Where should the full packet be unpacked
 * @param packet_information Where should all the information of the packet stored
 * @param start_of_payload Pointer where the payload starts
 * @return The length of the received payload
 */
static uint16_t unpack_packet(uint8_t *rx_destination,
			      const RAIL_RxPacketInfo_t *packet_information,
			      uint8_t **start_of_payload)
{
	RAIL_CopyRxPacket(rx_destination, packet_information);
	*start_of_payload = rx_destination;
	return packet_information->packetBytes;
}

static void rail_isr_installer(void)
{
#ifdef CONFIG_SOC_SERIES_EFR32MG24
	IRQ_CONNECT(SYNTH_IRQn, 0, SYNTH_IRQHandler, NULL, 0);
#else
	IRQ_CONNECT(RDMAILBOX_IRQn, 0, RDMAILBOX_IRQHandler, NULL, 0);
#endif
	IRQ_CONNECT(RAC_SEQ_IRQn, 0, RAC_SEQ_IRQHandler, NULL, 0);
	IRQ_CONNECT(RAC_RSM_IRQn, 0, RAC_RSM_IRQHandler, NULL, 0);
	IRQ_CONNECT(PROTIMER_IRQn, 0, PROTIMER_IRQHandler, NULL, 0);
	IRQ_CONNECT(MODEM_IRQn, 0, MODEM_IRQHandler, NULL, 0);
	IRQ_CONNECT(FRC_IRQn, 0, FRC_IRQHandler, NULL, 0);
	IRQ_CONNECT(BUFC_IRQn, 0, BUFC_IRQHandler, NULL, 0);
	IRQ_CONNECT(AGC_IRQn, 0, AGC_IRQHandler, NULL, 0);
}
```

## src/app_rail.h
```c
/***************************************************************************//**
 * @file app_rail.h
 * @brief RAIL configuration and handling functions.
 *******************************************************************************
 * # License
 * <b>Copyright 2024 Silicon Laboratories Inc. www.silabs.com</b>
 *******************************************************************************
 *
 * SPDX-License-Identifier: Zlib
 *
 * The licensor of this software is Silicon Laboratories Inc.
 *
 * This software is provided 'as-is', without any express or implied
 * warranty. In no event will the authors be held liable for any damages
 * arising from the use of this software.
 *
 * Permission is granted to anyone to use this software for any purpose,
 * including commercial applications, and to alter it and redistribute it
 * freely, subject to the following restrictions:
 *
 * 1. The origin of this software must not be misrepresented; you must not
 *    claim that you wrote the original software. If you use this software
 *    in a product, an acknowledgment in the product documentation would be
 *    appreciated but is not required.
 * 2. Altered source versions must be plainly marked as such, and must not be
 *    misrepresented as being the original software.
 * 3. This notice may not be removed or altered from any source distribution.
 *
 ******************************************************************************/

#ifndef APP_RAIL_H
#define APP_RAIL_H

// -----------------------------------------------------------------------------
// Public Function Declarations

/**
 * @brief Handle the process of sending a packet.
 *
 * Handles the process of sending a packet, preparing the package,
 * and initiating the transmission.
 *
 * @param packet_sent pointer to sending flag
 */
void handle_send(bool *packet_sent);

/**
 * @brief Handle the event of a successfully sent packet.
 *
 * Handles the event when a packet has been successfully sent.
 *
 * @param packet_sent pointer to sending flag
 */
void handle_sent(bool *packet_sent);

/**
 * @brief Handle a radio error event.
 *
 * Handles events where a radio error has occurred.
 *
 * @param error_code pointer to the error events happened with RAIL
 */
void handle_error(uint64_t *error_code);

/**
 * @brief Set continuous receive mode.
 *
 * Sets the radio to continuous receive mode or disables it based on the provided parameter.
 *
 * @param enable_continuous_rx Boolean indicating whether to enable continuous receive mode.
 */
void set_continuous_rx(bool enable_continuous_rx);

/**
 * @brief Handle the process of receiving packets.
 *
 * Handles the process of receiving packets, including unpacking and logging.
 */
void handle_receive(void);

/**
 * @brief Initialize the RAIL communication.
 *
 * Initializes RAIL communication, installs ISRs, and sets up the TX FIFO.
 */
void app_rail_init(void);

#endif /*APP_RAIL_H*/
```

## src/main.h
```c
/***************************************************************************//**
 * @file main.h
 * @brief Main header file for the proprietary TRX example.
 *******************************************************************************
 * # License
 * <b>Copyright 2024 Silicon Laboratories Inc. www.silabs.com</b>
 *******************************************************************************
 *
 * SPDX-License-Identifier: Zlib
 *
 * The licensor of this software is Silicon Laboratories Inc.
 *
 * This software is provided 'as-is', without any express or implied
 * warranty. In no event will the authors be held liable for any damages
 * arising from the use of this software.
 *
 * Permission is granted to anyone to use this software for any purpose,
 * including commercial applications, and to alter it and redistribute it
 * freely, subject to the following restrictions:
 *
 * 1. The origin of this software must not be misrepresented; you must not
 *    claim that you wrote the original software. If you use this software
 *    in a product, an acknowledgment in the product documentation would be
 *    appreciated but is not required.
 * 2. Altered source versions must be plainly marked as such, and must not be
 *    misrepresented as being the original software.
 * 3. This notice may not be removed or altered from any source distribution.
 *
 ******************************************************************************/

#ifndef MAIN_H
#define MAIN_H

// -----------------------------------------------------------------------------
// Includes

#include <zephyr/kernel.h>
#include <zephyr/device.h>
#include <zephyr/drivers/gpio.h>
#include <zephyr/sys/util.h>
#include <zephyr/sys/printk.h>
#include <inttypes.h>
#include <zephyr/shell/shell.h>
#include <zephyr/logging/log.h>
#include <zephyr/smf.h>

// -----------------------------------------------------------------------------
// Macros and Typedefs

// List of events
#define EVENT_REQUEST_SEND        BIT(0)
#define EVENT_CLI_RECEIVE_SETTING BIT(1)
#define EVENT_RADIO_RECEIVED      BIT(2)
#define EVENT_RADIO_SENT          BIT(3)
#define EVENT_RADIO_ERROR         BIT(4)

// A structure to contain all state machine, event, radio and gpio variables
struct s_prop_var {
	struct smf_ctx ctx;
	struct gpio_callback button_cb_data;
	struct k_event smf_event;
	bool allow_rx;
	bool packet_sent;
	uint64_t error_code;
	struct gpio_dt_spec led0;
	struct gpio_dt_spec led1;
	struct gpio_dt_spec button0;
	struct gpio_dt_spec button1;
};

// -----------------------------------------------------------------------------
// Global Variables

extern struct s_prop_var s_sl_machine;

#endif
```
